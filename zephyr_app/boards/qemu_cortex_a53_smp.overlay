/ {
    chosen {
		zephyr,sram = &sram1;
	};

    /* jailhouse config for zephyr assing memory area into 0x7000000 */
    soc {
		sram1: memory@70000000 {
			compatible = "mmio-sram";
			reg = <0x0 0x70000000 0x0 DT_SIZE_M(128)>;
		};

	};
};
