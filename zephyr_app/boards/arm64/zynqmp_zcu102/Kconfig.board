## zephyr_app/boards/arm64/zynqmp_zcu102/Kconfig.board
```kconfig
# Copyright (c) 2023 Linaro
# SPDX-License-Identifier: Apache-2.0

config BOARD_ZYNQMP_ZCU102
	bool "Bare minimum supported Xilinx ZynqMP board"
	depends on SOC_ZYNQMP_ZCU102
	select ARM64
```

## zephyr_app/boards/arm64/zynqmp_zcu102/Kconfig.defconfig
```kconfig
# Copyright (c) 2023 Linaro
# SPDX-License-Identifier: Apache-2.0

if BOARD_ZYNQMP_ZCU102

config BUILD_OUTPUT_BIN
	default y

config BOARD
	default "zynqmp_zcu102"

endif # BOARD_ZYNQMP_ZCU102
```

## zephyr_app/boards/arm64/zynqmp_zcu102/zynqmp_zcu102_defconfig
```kconfig
CONFIG_SOC_ZYNQMP_ZCU102=y
CONFIG_BOARD_ZYNQMP_ZCU102=y
CONFIG_ARM_ARCH_TIMER=y

# Cache management
CONFIG_CACHE_MANAGEMENT=y

# Enable UART driver
CONFIG_SERIAL=y
CONFIG_UART_INTERRUPT_DRIVEN=n

# Enable console
CONFIG_CONSOLE=y
CONFIG_UART_CONSOLE=y

# No pinctrl subsystem
CONFIG_PINCTRL=n
```

## zephyr_app/soc/arm64/zynqmp_zcu102/Kconfig.soc
```kconfig
# Copyright (c) 2023 Linaro
# SPDX-License-Identifier: Apache-2.0

config SOC_ZYNQMP_ZCU102
	bool "Xilinx ZynqMP ZCU102 platform (cortex-a53)"
	select ARM64
	select CPU_CORTEX_A53
	select GIC_V2
```
